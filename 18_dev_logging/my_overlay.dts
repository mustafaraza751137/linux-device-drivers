/dts-v1/;
/plugin/;

/ {
    fragment@0 {
        target-path = "/";
        __overlay__ {
            my_dev_label: my_device {
                compatible = "brightlight,mydev";
                status = "okay";
                string_val = "Hello, DT!";
                int_val = <123>;
            };
            my_device2@12345678 {
                compatible = "brightlight,mydev";
                status = "okay";
            };
        };
    };
};